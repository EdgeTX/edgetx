/* Application-only allocation. Never include original bootloader/RF bytes. */
STACK_ADDRESS = ORIGIN(CCM) + LENGTH(CCM);
MAIN_STACK_SIZE = 1024;
BOOTLOADER_SIZE = 0;
MIN_HEAP_SIZE = 0;
HEAP_ADDRESS = ORIGIN(RAM) + LENGTH(RAM);

MEMORY
{
  FLASH (rx) : ORIGIN = 0x0800C000, LENGTH = 720K
  RAM (xrw)  : ORIGIN = 0x20000000, LENGTH = 84K
  CCM (xrw)  : ORIGIN = 0x10000400, LENGTH = 63K
}

REGION_ALIAS("REGION_BOOTLOADER", FLASH);
REGION_ALIAS("REGION_ISR_VECT", FLASH);
REGION_ALIAS("REGION_TEXT", FLASH);
REGION_ALIAS("REGION_TEXT_STORAGE", FLASH);
REGION_ALIAS("REGION_DATA", CCM);
REGION_ALIAS("REGION_BSS", CCM);
REGION_ALIAS("REGION_RAM", RAM);
